## firmware/config/boards/shields/cesar/Kconfig.defconfig
```kconfig
# Copyright (c) 2020 The ZMK Contributors
# SPDX-License-Identifier: MIT

if SHIELD_CESAR

config ZMK_KEYBOARD_NAME
    default "Cesar"

endif
```

## firmware/config/boards/shields/cesar/Kconfig.shield
```kconfig
# Copyright (c) 2020 The ZMK Contributors
# SPDX-License-Identifier: MIT

config SHIELD_CESAR
    def_bool $(shields_list_contains,cesar)
```
